AUTOSAR XML (schema 3-1-5)
package /led_rte_extract_mpc5516it
  system led_rte_extract
    mapping led_rte_extract_mapping
      sw-impl-mappings:
        swc to impl mapping Blinker_prototypeImplMapping: component-implementation=BlinkerImplementation, component=led_rte_extract_softwareComposition.Blinker_prototype.Blinker_prototype
        swc to impl mapping EcuAbstraction_prototypeImplMapping: component-implementation=EcuAbstractionImplementation, component=led_rte_extract_softwareComposition.EcuAbstraction_prototype.EcuAbstraction_prototype
    software composition led_rte_extract_softwareComposition: software-composition=led_rte_extract_toplevelcomposition
  composition type led_rte_extract_toplevelcomposition
    component Blinker_prototype: type=Blinker
    component EcuAbstraction_prototype: type=EcuAbstraction
    connect EcuAbstraction_prototype.DigitalSignal_Led4 -> Blinker_prototype.LED_Port
