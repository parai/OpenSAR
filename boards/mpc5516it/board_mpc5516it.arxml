AUTOSAR XML (schema 3-1-5)
package /board_mpc5516it
  ecu configuration board_mpc5516it: ecu-sw-composition=SwComposition_board_mpc5516it, module=[Dio, Mcu, Port, EcuM]
  ecu sw composition SwComposition_board_mpc5516it
  module config Dio
    DioGeneral: DioDevErrorDetect=true, DioVersionInfoApi=true
    4 x DioPort, all with DioPortId=0:
      LED_PORT: ArcCoreDioPhysicalPort=DIO_PORT_D
        LEDS_LED4 (DioChannel): DioChannelId=52
        LEDS_LED5 (DioChannel): DioChannelId=53
        LED_GRP_PTR (DioChannelGroup): DioPortMask=48, DioPortOffset=0
      SPI_HOLD: ArcCoreDioPhysicalPort=DIO_PORT_G
        3 x DioChannel:
          SPI_A_HOLD_M95256: DioChannelId=97
          SPI_B_HOLD_M95256: DioChannelId=102
          SPI_A_HOLD_S25FL016: DioChannelId=101
      MISC_PORT: ArcCoreDioPhysicalPort=DIO_PORT_E
        S1 (DioChannel): DioChannelId=95
      PLAY: ArcCoreDioPhysicalPort=DIO_PORT_F
        OUTIN_0 (DioChannel): DioChannelId=80
        OUTIN_1 (DioChannel): DioChannelId=81
  module config Mcu
    McuGeneralConfiguration: McuDevErrorDetect=true, McuPerformResetApi=true, McuVersionInfoApi=true
    McuModuleConfiguration: McuClockSrcFailureNotification=DISABLED, McuNumberOfMcuModes=0, McuRamSectors=1, McuResetSetting=0
      McuClockSettingConfig: McuDefaultClockReference=EXT_REF_80MHZ
        3 x McuClockReferencePoint:
          EXT_REF_80MHZ: McuClockReferencePointFrequency=8000000.0, McuClockReferencePointPllEprediv=1, McuClockReferencePointPllEmfd=104, McuClockReferencePointPllErfd=5
          EXT_REF_66MHZ: McuClockReferencePointFrequency=1.6E7, McuClockReferencePointPllEprediv=3, McuClockReferencePointPllEmfd=83, McuClockReferencePointPllErfd=5
          XOSC_CAN: McuClockReferencePointFrequency=8000000.0, McuClockReferencePointPllEprediv=0, McuClockReferencePointPllEmfd=0, McuClockReferencePointPllErfd=0
      RUN (McuModeSettingConf): McuMode=0
      SLEEP (McuModeSettingConf): McuMode=0
  module config Port
    PortConfigSet
      7 x PortContainer:
        Misc
          3 x PortPin, all with PortPinPullMode=PULL_NONE, PortPinDirectionChangeable=false, PortPinHysteresisEnabled=false, PortPinOpenDrainEnabled=false, PortPinSlewRate=SLEW_RATE_MIN, PortPinLevelValue=PORT_PIN_LEVEL_LOW:
            BOOTCFG: PortPinDirection=PORT_PIN_IN, PortPinId=50, PortPinMode=PORT_PIN_MODE_OTHER
            PF[15]: PortPinDirection=PORT_PIN_IN, PortPinId=95, PortPinMode=PORT_PIN_MODE_DIO
            PF[0]: PortPinDirection=PORT_PIN_OUT, PortPinId=80, PortPinMode=PORT_PIN_MODE_DIO
        SPI_A
          7 x PortPin, all with PortPinPullMode=PULL_NONE, PortPinDirectionChangeable=false, PortPinHysteresisEnabled=false, PortPinOpenDrainEnabled=false:
            SIN_A: PortPinDirection=PORT_PIN_IN, PortPinId=69, PortPinSlewRate=SLEW_RATE_MAX, PortPinLevelValue=PORT_PIN_LEVEL_LOW, PortPinMode=PORT_PIN_MODE_SPI
            SOUT_A: PortPinDirection=PORT_PIN_OUT, PortPinId=68, PortPinSlewRate=SLEW_RATE_MAX, PortPinLevelValue=PORT_PIN_LEVEL_LOW, PortPinMode=PORT_PIN_MODE_SPI
            SCK_A: PortPinDirection=PORT_PIN_OUT, PortPinId=67, PortPinSlewRate=SLEW_RATE_MIN, PortPinLevelValue=PORT_PIN_LEVEL_LOW, PortPinMode=PORT_PIN_MODE_SPI
            PCS_A[1]: PortPinDirection=PORT_PIN_OUT, PortPinId=65, PortPinSlewRate=SLEW_RATE_MAX, PortPinLevelValue=PORT_PIN_LEVEL_LOW, PortPinMode=PORT_PIN_MODE_SPI
            PCS_A[2]: PortPinDirection=PORT_PIN_OUT, PortPinId=64, PortPinSlewRate=SLEW_RATE_MAX, PortPinLevelValue=PORT_PIN_LEVEL_LOW, PortPinMode=PORT_PIN_MODE_SPI
            PG[1]: PortPinDirection=PORT_PIN_OUT, PortPinId=97, PortPinSlewRate=SLEW_RATE_MAX, PortPinLevelValue=PORT_PIN_LEVEL_HIGH, PortPinMode=PORT_PIN_MODE_DIO
            PG[5]: PortPinDirection=PORT_PIN_OUT, PortPinId=101, PortPinSlewRate=SLEW_RATE_MAX, PortPinLevelValue=PORT_PIN_LEVEL_HIGH, PortPinMode=PORT_PIN_MODE_DIO
        SPI_B
          5 x PortPin, all with PortPinPullMode=PULL_NONE, PortPinDirectionChangeable=false, PortPinHysteresisEnabled=false, PortPinOpenDrainEnabled=false:
            SIN_B: PortPinDirection=PORT_PIN_IN, PortPinId=63, PortPinSlewRate=SLEW_RATE_MIN, PortPinLevelValue=PORT_PIN_LEVEL_LOW, PortPinMode=PORT_PIN_MODE_SPI
            SOUT_B: PortPinDirection=PORT_PIN_OUT, PortPinId=62, PortPinSlewRate=SLEW_RATE_MIN, PortPinLevelValue=PORT_PIN_LEVEL_LOW, PortPinMode=PORT_PIN_MODE_SPI
            SCK_B: PortPinDirection=PORT_PIN_OUT, PortPinId=61, PortPinSlewRate=SLEW_RATE_MIN, PortPinLevelValue=PORT_PIN_LEVEL_LOW, PortPinMode=PORT_PIN_MODE_SPI
            PCS_B[0]: PortPinDirection=PORT_PIN_OUT, PortPinId=60, PortPinSlewRate=SLEW_RATE_MAX, PortPinLevelValue=PORT_PIN_LEVEL_LOW, PortPinMode=PORT_PIN_MODE_SPI
            PG[6]: PortPinDirection=PORT_PIN_OUT, PortPinId=102, PortPinSlewRate=SLEW_RATE_MIN, PortPinLevelValue=PORT_PIN_LEVEL_HIGH, PortPinMode=PORT_PIN_MODE_DIO
        LIN_B
          TXD_B (PortPin):
            PortPinPullMode = PULL_NONE
            PortPinDirection = PORT_PIN_OUT
            PortPinDirectionChangeable = false
            PortPinHysteresisEnabled = false
            PortPinOpenDrainEnabled = true
            PortPinId = 56
            PortPinSlewRate = SLEW_RATE_MAX
            PortPinLevelValue = PORT_PIN_LEVEL_LOW
            PortPinMode = PORT_PIN_MODE_OTHER_1
          RXD_B (PortPin):
            PortPinPullMode = PULL_NONE
            PortPinDirection = PORT_PIN_IN
            PortPinDirectionChangeable = false
            PortPinHysteresisEnabled = false
            PortPinOpenDrainEnabled = false
            PortPinId = 57
            PortPinSlewRate = SLEW_RATE_MAX
            PortPinLevelValue = PORT_PIN_LEVEL_LOW
            PortPinMode = PORT_PIN_MODE_OTHER_1
        LED
          PD[4] (PortPin):
            PortPinPullMode = PULL_NONE
            PortPinDirection = PORT_PIN_OUT
            PortPinDirectionChangeable = false
            PortPinHysteresisEnabled = false
            PortPinOpenDrainEnabled = false
            PortPinId = 52
            PortPinSlewRate = SLEW_RATE_MIN
            PortPinLevelValue = PORT_PIN_LEVEL_LOW
            PortPinMode = PORT_PIN_MODE_DIO
          PD[5] (PortPin):
            PortPinPullMode = PULL_NONE
            PortPinDirection = PORT_PIN_OUT
            PortPinDirectionChangeable = false
            PortPinHysteresisEnabled = false
            PortPinOpenDrainEnabled = false
            PortPinId = 53
            PortPinSlewRate = SLEW_RATE_MIN
            PortPinLevelValue = PORT_PIN_LEVEL_LOW
            PortPinMode = PORT_PIN_MODE_DIO
        CAN_A
          CNTX_A (PortPin):
            PortPinPullMode = PULL_NONE
            PortPinDirection = PORT_PIN_OUT
            PortPinDirectionChangeable = false
            PortPinHysteresisEnabled = false
            PortPinOpenDrainEnabled = false
            PortPinId = 48
            PortPinSlewRate = SLEW_RATE_MIN
            PortPinLevelValue = PORT_PIN_LEVEL_LOW
            PortPinMode = PORT_PIN_MODE_CAN
          CNRX_A (PortPin):
            PortPinPullMode = PULL_NONE
            PortPinDirection = PORT_PIN_IN
            PortPinDirectionChangeable = false
            PortPinHysteresisEnabled = false
            PortPinOpenDrainEnabled = false
            PortPinId = 49
            PortPinSlewRate = SLEW_RATE_MIN
            PortPinLevelValue = PORT_PIN_LEVEL_LOW
            PortPinMode = PORT_PIN_MODE_CAN
        SerialPort
          RXD_D (PortPin):
            PortPinPullMode = PULL_NONE
            PortPinDirection = PORT_PIN_IN
            PortPinDirectionChangeable = false
            PortPinHysteresisEnabled = false
            PortPinOpenDrainEnabled = false
            PortPinId = 93
            PortPinSlewRate = SLEW_RATE_MIN
            PortPinLevelValue = PORT_PIN_LEVEL_LOW
            PortPinMode = PORT_PIN_MODE_OTHER_2
          TXD_D (PortPin):
            PortPinPullMode = PULL_NONE
            PortPinDirection = PORT_PIN_OUT
            PortPinDirectionChangeable = false
            PortPinHysteresisEnabled = false
            PortPinOpenDrainEnabled = false
            PortPinId = 92
            PortPinSlewRate = SLEW_RATE_MIN
            PortPinLevelValue = PORT_PIN_LEVEL_LOW
            PortPinMode = PORT_PIN_MODE_OTHER_2
    PortGeneral: PortDevErrorDetect=true, PortSetPinDirectionApi=true, PortSetPinModeApi=true, PortVersionInfoApi=true
  module config EcuM
    EcuMGeneral: EcuMDevErrorDetect=false, EcuMIncludeNvramMgr=false, EcuMVersionInfoApi=false, EcuMMainFunctionPeriod=0.2
    EcuMConfiguration: EcuMNvramReadallTimeout=10.0, EcuMRunMinimumDuration=10.0, EcuMNvramWriteallTimeout=10.0
      User_1 (EcuMUserConfig)
      EcuMDefaultShutdownTarget: EcuMDefaultState=EcuMStateReset, EcuMDefaultSleepModeRef=(unset)
      EcuMSleepMode: EcuMSleepModeId=0, EcuMSleepModeSuspend=false, EcuMSleepModeMcuModeRef=SLEEP, EcuMWakeupSourceMask=EcuMWakeupSource
      EcuMWakeupSource: EcuMResetReason=0, EcuMValidationTimeout=0.0, EcuMWakeupSourceId=0, EcuMWakeupSourcePolling=false
