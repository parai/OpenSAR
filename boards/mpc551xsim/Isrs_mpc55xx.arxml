AUTOSAR XML (schema 3-1-4)
package /Isrs_mpc55xx
  ecu configuration Isrs_mpc55xx: ecu-sw-composition=SwComposition_Isrs_mpc55xx, module=Os
  ecu sw composition SwComposition_Isrs_mpc55xx
  module config Os
    OsOS:
      OsStackMonitoring = true
      OsStatus = EXTENDED
      OsUseGetServiceId = true
      OsUseParameterAccess = true
      OsUseResScheduler = true
      OsTickFrequency = 1000
      OsInterruptStackSize = 2048
      OsIdleStackSize = 512
      ArcCoreOsUseDebug = false
      ArcCoreOsDebugTask = false
      ArcCoreOsDebugAlarm = false
      ArcCoreOsDebugResource = false
      ArcCoreOsDebugScheduleTable = false
      ArcCoreOsDebugEvent = false
      OsNumberOfCores = 1
      ArcOsIsrMaxCount = 10
      OsHooks: OsErrorHook=true, OsPostTaskHook=true, OsPreTaskHook=true, OsProtectionHook=false, OsShutdownHook=true, OsStartupHook=true
    151 x OsIsr, all with ArcOsIsrPriority=2, OsIsrCategory=CATEGORY_2:
      Adc_Err: ArcOsIsrVector=EQADC_FISR_OVER, ArcOsIsrCallbackName=Adc_EQADCError
      Adc_Grp0: ArcOsIsrVector=EQADC_FISR0_EOQF0, ArcOsIsrCallbackName=Adc_Group0ConversionComplete
      Adc_Grp1: ArcOsIsrVector=EQADC_FISR1_EOQF1, ArcOsIsrCallbackName=Adc_Group1ConversionComplete
      CanA_BO: ArcOsIsrVector=FLEXCAN_A_ESR_BOFF_INT, ArcOsIsrCallbackName=Can_A_BusOff
      CanA_E: ArcOsIsrVector=FLEXCAN_A_ESR_ERR_INT, ArcOsIsrCallbackName=Can_A_Err
      CanA_31_16: ArcOsIsrVector=FLEXCAN_A_IFLAG1_BUF31_16I, ArcOsIsrCallbackName=Can_A_Isr
      CanA_{0..15}: ArcOsIsrVector=FLEXCAN_A_IFLAG1_BUF{0..15}I, ArcOsIsrCallbackName=Can_A_Isr
      CanB_BO: ArcOsIsrVector=FLEXCAN_B_ESR_BOFF_INT, ArcOsIsrCallbackName=Can_B_BusOff
      CanB_E: ArcOsIsrVector=FLEXCAN_B_ESR_ERR_INT, ArcOsIsrCallbackName=Can_B_Err
      CanB_31_16: ArcOsIsrVector=FLEXCAN_B_IFLAG1_BUF31_16I, ArcOsIsrCallbackName=Can_B_Isr
      CanB_{0..15}: ArcOsIsrVector=FLEXCAN_B_IFLAG1_BUF{0..15}I, ArcOsIsrCallbackName=Can_B_Isr
      CanC_BO: ArcOsIsrVector=FLEXCAN_C_ESR_BOFF_INT, ArcOsIsrCallbackName=Can_C_BusOff
      CanC_E: ArcOsIsrVector=FLEXCAN_C_ESR_ERR_INT, ArcOsIsrCallbackName=Can_C_Err
      CanC_31_16: ArcOsIsrVector=FLEXCAN_C_IFLAG1_BUF31_16I, ArcOsIsrCallbackName=Can_C_Isr
      CanC_{0..15}: ArcOsIsrVector=FLEXCAN_C_IFLAG1_BUF{0..15}I, ArcOsIsrCallbackName=Can_C_Isr
      CanD_BO: ArcOsIsrVector=FLEXCAN_D_ESR_BOFF_INT, ArcOsIsrCallbackName=Can_D_BusOff
      CanD_E: ArcOsIsrVector=FLEXCAN_D_ESR_ERR_INT, ArcOsIsrCallbackName=Can_D_Err
      CanD_31_16: ArcOsIsrVector=FLEXCAN_D_IFLAG1_BUF31_16I, ArcOsIsrCallbackName=Can_D_Isr
      CanD_{0..15}: ArcOsIsrVector=FLEXCAN_D_IFLAG1_BUF{0..15}I, ArcOsIsrCallbackName=Can_D_Isr
      CanE_BO: ArcOsIsrVector=FLEXCAN_E_ESR_BOFF_INT, ArcOsIsrCallbackName=Can_E_BusOff
      CanE_E: ArcOsIsrVector=FLEXCAN_E_ESR_ERR_INT, ArcOsIsrCallbackName=Can_E_Err
      CanE_31_16: ArcOsIsrVector=FLEXCAN_E_IFLAG1_BUF31_16I, ArcOsIsrCallbackName=Can_E_Isr
      CanE_{0..15}: ArcOsIsrVector=FLEXCAN_E_IFLAG1_BUF{0..15}I, ArcOsIsrCallbackName=Can_E_Isr
      CanF_BO: ArcOsIsrVector=FLEXCAN_F_ESR_BOFF_INT, ArcOsIsrCallbackName=Can_F_BusOff
      CanF_E: ArcOsIsrVector=FLEXCAN_F_ESR_ERR_INT, ArcOsIsrCallbackName=Can_F_Err
      CanF_31_16: ArcOsIsrVector=FLEXCAN_F_IFLAG1_BUF31_16I, ArcOsIsrCallbackName=Can_F_Isr
      CanF_{0..15}: ArcOsIsrVector=FLEXCAN_F_IFLAG1_BUF{0..15}I, ArcOsIsrCallbackName=Can_F_Isr
      Gpt_0: ArcOsIsrVector=PIT_PITFLG_RTIF, ArcOsIsrCallbackName=Gpt_Isr_Channel0
      Gpt_{1..8}: ArcOsIsrVector=PIT_PITFLG_PIT{1..8}, ArcOsIsrCallbackName=Gpt_Isr_Channel{1..8}
      LinA: ArcOsIsrVector=SCI_A_COMB, ArcOsIsrCallbackName=LinInterruptA
      LinB: ArcOsIsrVector=SCI_B_COMB, ArcOsIsrCallbackName=LinInterruptB
      LinC: ArcOsIsrVector=SCI_C_COMB, ArcOsIsrCallbackName=LinInterruptC
      LinD: ArcOsIsrVector=SCI_D_COMB, ArcOsIsrCallbackName=LinInterruptD
      LinE: ArcOsIsrVector=SCI_E_COMB, ArcOsIsrCallbackName=LinInterruptE
      LinF: ArcOsIsrVector=SCI_F_COMB, ArcOsIsrCallbackName=LinInterruptF
      LinG: ArcOsIsrVector=SCI_G_COMB, ArcOsIsrCallbackName=LinInterruptG
      LinH: ArcOsIsrVector=SCI_H_COMB, ArcOsIsrCallbackName=LinInterruptH
      Pwm{0..15}: ArcOsIsrVector=EMISOS200_FLAG_F{0..15}, ArcOsIsrCallbackName=Pwm_Isr
      OsTick: ArcOsIsrVector=INTC_SSCIR0_CLR7, ArcOsIsrCallbackName=OsTick
    OsApplication1 (OsApplication):
      ArcOsAppCoreId = 0
      OsTrusted = false
      OsAppIsrRef = Adc_Err
      OsAppIsrRef = Adc_Grp0
      OsAppIsrRef = Adc_Grp1
      OsAppIsrRef = CanA_BO
      OsAppIsrRef = CanA_E
      OsAppIsrRef = CanA_31_16
      OsAppIsrRef = CanA_{0..15}
      OsAppIsrRef = CanB_BO
      OsAppIsrRef = CanB_E
      OsAppIsrRef = CanB_31_16
      OsAppIsrRef = CanB_{0..15}
      OsAppIsrRef = CanC_BO
      OsAppIsrRef = CanC_E
      OsAppIsrRef = CanC_31_16
      OsAppIsrRef = CanC_{0..15}
      OsAppIsrRef = CanD_BO
      OsAppIsrRef = CanD_E
      OsAppIsrRef = CanD_31_16
      OsAppIsrRef = CanD_{0..15}
      OsAppIsrRef = CanE_BO
      OsAppIsrRef = CanE_E
      OsAppIsrRef = CanE_31_16
      OsAppIsrRef = CanE_{0..15}
      OsAppIsrRef = CanF_BO
      OsAppIsrRef = CanF_E
      OsAppIsrRef = CanF_31_16
      OsAppIsrRef = CanF_{0..15}
      OsAppIsrRef = Gpt_{0..8}
      OsAppIsrRef = LinA
      OsAppIsrRef = LinB
      OsAppIsrRef = LinC
      OsAppIsrRef = LinD
      OsAppIsrRef = LinE
      OsAppIsrRef = LinF
      OsAppIsrRef = LinG
      OsAppIsrRef = LinH
      OsAppIsrRef = Pwm{0..15}
      OsAppIsrRef = OsTick
      OsApplicationHooks: OsAppErrorHook=false, OsAppShutdownHook=false, OsAppStartupHook=false
