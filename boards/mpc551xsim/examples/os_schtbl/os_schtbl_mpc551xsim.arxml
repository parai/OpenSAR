AUTOSAR XML (schema 3-1-5)
package /os_schtbl_mpc551xsim
  ecu configuration os_schtbl_mpc551xsim: ecu-sw-composition=SwComposition_os_schtbl_mpc551xsim, module=[Mcu, Os, EcuM, Det]
  ecu sw composition SwComposition_os_schtbl_mpc551xsim
  module config Mcu
    McuGeneralConfiguration: McuDevErrorDetect=true, McuPerformResetApi=true, McuVersionInfoApi=true
    McuModuleConfiguration: McuClockSrcFailureNotification=DISABLED, McuNumberOfMcuModes=0, McuRamSectors=1, McuResetSetting=0
      McuClockSettingConfig: McuDefaultClockReference=EXT_REF_80MHZ
        EXT_REF_80MHZ (McuClockReferencePoint): McuClockReferencePointFrequency=8000000.0, McuClockReferencePointPllEprediv=1, McuClockReferencePointPllEmfd=104, McuClockReferencePointPllErfd=5
        EXT_REF_66MHZ (McuClockReferencePoint): McuClockReferencePointFrequency=1.6E7, McuClockReferencePointPllEprediv=3, McuClockReferencePointPllEmfd=83, McuClockReferencePointPllErfd=5
      RUN (McuModeSettingConf): McuMode=0
      SLEEP (McuModeSettingConf): McuMode=0
  module config Os
    OsOS:
      OsStackMonitoring = true
      OsStatus = EXTENDED
      OsUseGetServiceId = true
      OsUseParameterAccess = true
      OsUseResScheduler = true
      OsTickFrequency = 100
      OsInterruptStackSize = 2048
      OsIdleStackSize = 512
      ArcCoreOsUseDebug = false
      ArcCoreOsDebugTask = false
      ArcCoreOsDebugAlarm = false
      ArcCoreOsDebugResource = false
      ArcCoreOsDebugScheduleTable = false
      ArcCoreOsDebugEvent = false
      ArcOsIsrMaxCount = 10
      OsNumberOfCores = 1
      OsHooks: OsErrorHook=true, OsPostTaskHook=true, OsPreTaskHook=true, OsProtectionHook=false, OsShutdownHook=true, OsStartupHook=true
    OsApplication1 (OsApplication):
      ArcOsAppCoreId = 0
      OsTrusted = false
      OsAppCounterRef = Counter1
      OsAppScheduleTableRef = ScheduleTable_1
      OsAppTaskRef = eTask1
      OsAppTaskRef = eTask2
      OsAppTaskRef = bTask3
      OsApplicationHooks: OsAppErrorHook=false, OsAppShutdownHook=false, OsAppStartupHook=false
    Counter1 (OsCounter): OsCounterMaxAllowedValue=65535, OsCounterMinCycle=1, OsCounterTicksPerBase=0, OsCounterType=OS_TICK
    Event1 (OsEvent): OsEventMask=16, ArcOsEventAutoMask=false, ArcOsEventId=0
    Event2 (OsEvent): OsEventMask=1, ArcOsEventAutoMask=true, ArcOsEventId=0
    ScheduleTable_1 (OsScheduleTable): OsScheduleTableDuration=10, OsScheduleTableRepeating=true, OsScheduleTableCounterRef=Counter1
      3 x OsScheduleTableExpiryPoint:
        ExpiryPoint: OsScheduleTblExpPointOffset=2
          TaskActivation1 (OsScheduleTableTaskActivation): OsScheduleTableActivateTaskRef=bTask3
        ExpiryPoint1: OsScheduleTblExpPointOffset=4
          EventSetting1 (OsScheduleTableEventSetting): OsScheduleTableSetEventRef=Event1, OsScheduleTableSetEventTaskRef=eTask1
        ExpiryPoint2: OsScheduleTblExpPointOffset=8
          EventSetting1 (OsScheduleTableEventSetting): OsScheduleTableSetEventRef=Event2, OsScheduleTableSetEventTaskRef=eTask2
      OsScheduleTableAutostart: OsScheduleTableAutostartType=ABSOLUTE, ArcCoreOsScheduleTableOffset=10
      ExpiryPoint4 (OsScheduleTableExpiryPoint): OsScheduleTblExpPointOffset=9
        EventSetting1 (OsScheduleTableEventSetting): OsScheduleTableSetEventRef=Event1, OsScheduleTableSetEventTaskRef=eTask1
        TaskActivation1 (OsScheduleTableTaskActivation): OsScheduleTableActivateTaskRef=bTask3
    3 x OsTask, all with OsTaskActivation=1, OsTaskPriority=1, ArcCoreOsTaskStackSize=2048, OsTaskSchedule=FULL:
      eTask1: OsTaskProcessType=EXTENDED, OsTaskEventRef=Event1
        OsTaskAutostart
      eTask2: OsTaskProcessType=EXTENDED, OsTaskEventRef=Event2
        OsTaskAutostart
      bTask3: OsTaskProcessType=BASIC
  module config EcuM
    EcuMGeneral: EcuMDevErrorDetect=false, EcuMIncludeNvramMgr=false, EcuMVersionInfoApi=false, EcuMMainFunctionPeriod=0.2
    EcuMConfiguration: EcuMNvramReadallTimeout=10.0, EcuMRunMinimumDuration=10.0, EcuMNvramWriteallTimeout=10.0
      User_1 (EcuMUserConfig)
      EcuMDefaultShutdownTarget: EcuMDefaultState=EcuMStateReset, EcuMDefaultSleepModeRef=(unset)
      EcuMSleepMode: EcuMSleepModeId=0, EcuMSleepModeSuspend=false, EcuMSleepModeMcuModeRef=RUN, EcuMWakeupSourceMask=EcuMWakeupSource
      EcuMWakeupSource: EcuMResetReason=0, EcuMValidationTimeout=0.0, EcuMWakeupSourceId=0, EcuMWakeupSourcePolling=false
  module config Det
    DetGeneral: DetEnableCallbacks=false, DetUseRamlog=true, DetWrapRamlog=true, DetUseStdErr=false, DetDeInitAPI=false, DetNumberOfCallbacks=5, DetRamlogSize=16
