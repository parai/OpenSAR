AUTOSAR XML (schema 3-2-1)
package /os_simple_stm32_mcbstm32
  ecu configuration os_simple_stm32_mcbstm32: ecu-sw-composition=SwComposition_os_simple_stm32_mcbstm32, module=[Os, EcuM, Mcu]
  ecu sw composition SwComposition_os_simple_stm32_mcbstm32
  module config Os
    OsOS:
      OsStackMonitoring = true
      OsStatus = EXTENDED
      OsUseGetServiceId = true
      OsUseParameterAccess = true
      OsUseResScheduler = true
      OsTickFrequency = 1000
      OsInterruptStackSize = 2048
      OsIdleStackSize = 512
      ArcCoreOsUseDebug = false
      ArcCoreOsDebugTask = false
      ArcCoreOsDebugAlarm = false
      ArcCoreOsDebugResource = false
      ArcCoreOsDebugScheduleTable = false
      ArcCoreOsDebugEvent = false
      ArcOsIsrMaxCount = 10
      OsNumberOfCores = 1
      OsHooks: OsErrorHook=true, OsPostTaskHook=true, OsPreTaskHook=true, OsProtectionHook=false, OsShutdownHook=true, OsStartupHook=true
    Alarm1 (OsAlarm): OsAlarmCounterRef=Counter1
      OsAlarmAction
        OsAlarmSetEvent: OsAlarmSetEventRef=Event2, OsAlarmSetEventTaskRef=eTask1
      OsAlarmAutostart: OsAlarmAlarmTime=100, OsAlarmAutostartType=RELATIVE, OsAlarmCycleTime=100
      OsAlarmSetEvent: OsAlarmSetEventRef=Event2, OsAlarmSetEventTaskRef=eTask1
    Counter1 (OsCounter): OsCounterMaxAllowedValue=65535, OsCounterMinCycle=1, OsCounterTicksPerBase=0, OsCounterType=OS_TICK
    3 x OsTask, all with OsTaskActivation=1, OsTaskPriority=1, ArcCoreOsTaskStackSize=2048, OsTaskSchedule=FULL:
      bTask3: OsTaskProcessType=BASIC
      eTask1: OsTaskProcessType=EXTENDED, OsTaskEventRef=Event2
        OsTaskAutostart
      eTask2: OsTaskProcessType=EXTENDED, OsTaskEventRef=Event1
        OsTaskAutostart
    Event1 (OsEvent): OsEventMask=1, ArcOsEventAutoMask=true, ArcOsEventId=0
    Event2 (OsEvent): OsEventMask=2, ArcOsEventAutoMask=true, ArcOsEventId=0
    OsApplication1 (OsApplication): ArcOsAppCoreId=0, OsTrusted=false, OsAppAlarmRef=Alarm1, OsAppCounterRef=Counter1, OsAppTaskRef=bTask3, OsAppTaskRef=eTask1, OsAppTaskRef=eTask2
      OsApplicationHooks: OsAppErrorHook=false, OsAppShutdownHook=false, OsAppStartupHook=false
  module config EcuM
    EcuMGeneral: EcuMDevErrorDetect=false, EcuMIncludeNvramMgr=false, EcuMVersionInfoApi=false, EcuMMainFunctionPeriod=0.2
    EcuMConfiguration: EcuMNvramReadallTimeout=10.0, EcuMRunMinimumDuration=10.0, EcuMNvramWriteallTimeout=10.0
      User_1 (EcuMUserConfig)
      EcuMDefaultShutdownTarget: EcuMDefaultState=EcuMStateReset, EcuMDefaultSleepModeRef=(unset)
      EcuMSleepMode: EcuMSleepModeId=0, EcuMSleepModeSuspend=false, EcuMSleepModeMcuModeRef=SLEEP, EcuMWakeupSourceMask=EcuMWakeupSource
      EcuMWakeupSource: EcuMResetReason=0, EcuMValidationTimeout=0.0, EcuMWakeupSourceId=0, EcuMWakeupSourcePolling=false
  module config Mcu
    McuGeneralConfiguration: McuDevErrorDetect=false, McuPerformResetApi=true, McuVersionInfoApi=true
    McuModuleConfiguration: McuClockSrcFailureNotification=DISABLED, McuNumberOfMcuModes=0, McuRamSectors=1, McuResetSetting=0
      McuClockSettingConfig:
        ArcAHBClocksEnable = DMA1
        ArcAPB1ClocksEnable = TIM2
        ArcAPB1ClocksEnable = TIM4
        ArcAPB1ClocksEnable = TIM3
        ArcAPB1ClocksEnable = CAN1
        ArcAPB2ClocksEnable = AFIO
        ArcAPB2ClocksEnable = GPIOA
        ArcAPB2ClocksEnable = GPIOB
        ArcAPB2ClocksEnable = GPIOC
        ArcAPB2ClocksEnable = TIM1
        ArcAPB2ClocksEnable = ADC1
        McuDefaultClockReference = Clock
        Clock (McuClockReferencePoint): McuClockReferencePointFrequency=8000000.0, McuClockReferencePointPllEprediv=9, McuClockReferencePointPllEmfd=0, McuClockReferencePointPllErfd=0
      RUN (McuModeSettingConf): McuMode=0
      SLEEP (McuModeSettingConf): McuMode=0
